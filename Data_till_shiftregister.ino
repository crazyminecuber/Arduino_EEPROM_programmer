



#define clockPin 12
#define shiftPin 13
#define pulsTid 50
#define IO0 2
#define IO1 3
#define IO2 4
#define IO3 5
#define IO4 6
#define IO5 7
#define IO6 8
#define IO7 9
#define CE 10
#define addressLines 8192
#define writeFlag B10100000
#define readFlag  B11000000
#define resetFlag B10011111
#define dbReadByte false
#define dbSetAddress false
#define dbEnableChip false
#define dbWriteByte false
#define antalChip 3 
#define KontrollSignaler 24



enum Mode { WriteMode, ReadMode};


/*
Shiftregistret innehåller alla adresser + OE och WE

*/

const byte dataA[] = {B00000000, B00000010, B00000000, B00000000, B00000000, B00000000, B00000000, B00000000, 

B00000000, B00000010, B00000000, B00000000, B00000000, B00000000, B00000000, B00000000, 

B00000000, B00000010, B00000000, B00000000, B00000000, B00000000, B00000000, B00000000, 
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B00000000, B00000010, B00000000, B00000000, B00000000, B00000000, B00000000, B00000000, 



};



  const byte dataB[] = {B00010000, B00000000, B00000000, B00000100, B00000000, B00000000, B00000000, B00000000, 

B00010000, B00000000, B00000000, B00000100, B00000000, B00000000, B00000000, B00000000, 

B00010000, B00000000, B00000000, B00000100, B00000000, B00000000, B00000000, B00000000, 
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B00010000, B00000000, B00000000, B00000100, B00000000, B00000000, B00000000, B00000000, 




};



  const byte dataC[] = {B00000010, B00000100, B00000000, B00000000, B00000000, B00000000, B00000000, B00000000, 

B00000010, B00000100, B00000000, B00000000, B00000000, B00000000, B00000000, B00000000, 

B00000010, B00000100, B00000000, B00000000, B00000000, B00000000, B00000000, B00000000, 
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B00000010, B00000100, B00000000, B00000000, B00000000, B00000000, B00000000, B00000000, 




};


  const PROGMEM uint16_t addresser[] = {0, 1, 2, 3, 4, 5, 6, 7, 128, 129, 130, 131, 132,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 511,}; 
  
  
  void setup()
{
   startSekvens();
  /* Serial.print("Data ");
   Serial.println(dataC[34]);
   Serial.print("Addresser ");
   Serial.println(addresser[34]);
    delay(1000);
   writeByte(dataC[34], addresser[34]);*/
  doTheThing();
  slutSekvens();
}

void doTheThing()
{
  int addresslangd = sizeof(addresser)/ sizeof(int);
  Serial.println(addresslangd);
  for(int i = 0; i < addresslangd; i ++)
  {
    /*Serial.print("i = ");
    Serial.println(i);
    Serial.print("addresser[i] = ");
    Serial.println(pgm_read_word_near(addresser + i));*/
    writeByte(dataC[i], pgm_read_word_near(addresser + i));
  }
  enableChip(false);
  Serial.println("Done");
  enableChip(false);
}
void readEEPROM()
{
  for(int i = 0; i < 4; i++)
  {
    for(int j = 0; j < 16; j++)
      {
        for(int k = 0; k < 8; k++)
        {
          
        }
      }
  }
}

void loop()
{
  //Does so that one can type a number into monitor and get the chip to display the data at that address
 if(Serial.available()> 0)
 {
    String input = Serial.readString();
    int tal = input.toInt();
    Serial.print("Läser ");
    Serial.println(tal, BIN);
    setAddress(tal, ReadMode);
    Serial.print("Datan är ");
    Serial.println(readByte(tal), BIN);
    enableChip(true);
  }
}





















//Shiftar en int ett visst antal binära steg åt båda riktningarna
int shiftTal(int tal, int shiftSteps)
{
  if(shiftSteps < 0)
  {
    for(shiftSteps; shiftSteps < 0; shiftSteps++)
    {
      if(tal == 1) tal = 0; 
      else tal/= 2;
    }
  }
  else
  {
    for(shiftSteps; shiftSteps > 0; shiftSteps--)
    {
      if(tal == 0)tal = 1;
      tal*= 2;
    }
  }
  return tal;
}

//Writes one byte to specified address
void writeByte(byte data, uint16_t address)
{
  enableChip(false);
  setModePins(WriteMode);
  if(dbWriteByte)Serial.print("Writing byte ");
  if(dbWriteByte)Serial.print(data);
  if(dbWriteByte)Serial.print(" , To address ");
  if(dbWriteByte)Serial.println(address);
  if(setAddress(address, WriteMode)){
    for(int i = IO0; i <= IO7; i++)
    { 
       digitalWrite(i, bitRead(data, i - IO0));
      Serial.println(bitRead(data, i - IO0));
   }
   enableChip(true);
   delay(1);
  
  
  enableChip(false);
  delay(1);
  }
}



//Reads one byte from a specifed address
byte readByte(int address)
{
  enableChip(false);
  setModePins(ReadMode);
  if(dbReadByte)Serial.println("Reading EEPROM");
  //sets address and readmode
  if(setAddress(address, ReadMode)){
    enableChip(true);
    //Reads data from IO7 to IO0 by shifting left and adding as the least significant bit
    byte data = 0;
    for(int i = IO7; i >= IO0; i --)
    {
      data = (data << 1 )+ digitalRead(i);
    }
    if(dbReadByte)Serial.print("Read byte ");
    if(dbReadByte)Serial.println(data, HEX);
    if(dbReadByte)Serial.println("");
    return data;
  }
}


//sets address + mode
// checks that address is ok
bool setAddress(int address, Mode mode)
{
  enableChip(false);
  //If address is ok set up for transfer
  if(dbSetAddress)Serial.println(address);
  if(address >= 0 && address < addressLines)
  {
    if(dbSetAddress)Serial.print("Address and mode OK. Setting address to ");
    if(dbSetAddress)Serial.println(address);
    
    //transfer 8 LSBs
    shiftOut(shiftPin, clockPin, LSBFIRST, address);

    //fixes highest bits and bitwise or with flag for write and read
    byte secoundByte = address >> 8;
    secoundByte = secoundByte & resetFlag ;//tar bort overflowdata som kan påverka om write enbale är av
    secoundByte = secoundByte | (mode == WriteMode ? writeFlag  : readFlag);
    if(dbSetAddress)Serial.print("Secoundbyte in address = ");
    if(dbSetAddress)Serial.println(secoundByte, BIN);
    shiftOut(shiftPin, clockPin,LSBFIRST, secoundByte);
    delay(1);
    return true;
  }
  else Serial.println("The requested address was not allowed.");
  return false;
}
















void startSekvens()
{
  pinMode(clockPin, OUTPUT);
  pinMode(shiftPin, OUTPUT);
  pinMode(CE, OUTPUT);
  enableChip(false);
  Serial.begin(9600);
}

void slutSekvens()
{
  readByte(0);
  setModePins(ReadMode);
  enableChip(true);
}

//Enables/ diables chip depending on state variable
void enableChip(bool state)
{
  delay(1);
  if(state == true) 
  {   
    if(dbEnableChip)Serial.println("Chip enabled");
    digitalWrite(CE, LOW);
  }
  else 
  {
    if(dbEnableChip)Serial.println("Chip disabled");
    digitalWrite(CE, HIGH);
  }
  delay(1);
  
}

//Sets all IO pins to either output or input depending on mode
void setModePins(Mode mode)
{
  if(mode == WriteMode)
  {
    for(int i = IO0; i <= IO7; i++)
    {
      pinMode(i, OUTPUT);
    }
  }
  else
  {
    for(int i = IO0; i <= IO7; i++)
    {
      pinMode(i, INPUT);
    }
  }
}










